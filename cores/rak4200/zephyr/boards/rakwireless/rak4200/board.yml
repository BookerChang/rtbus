## cores/rak4200/zephyr/boards/rakwireless/rak4200/board.yml
```yaml
board:
  name: rak4200
  full_name: RAK4200
  vendor: rakwireless
  socs:
    - name: stm32l071xx
```

## runtime/zephyr/boards/boards/rakwireless/rak4200/Kconfig.defconfig
```kconfig
# SPDX-License-Identifier: Apache-2.0

if BOARD_RAK4200

config SPI_STM32_INTERRUPT
	default y
	depends on SPI

endif # BOARD_RAK4200
```

## runtime/zephyr/boards/boards/rakwireless/rak4200/Kconfig.rak4200
```kconfig
# SPDX-License-Identifier: Apache-2.0

config BOARD_RAK4200
	select SOC_STM32L071XX
```

## runtime/zephyr/modules/mod_fw_component/Kconfig
```kconfig
menu "WisMOD Firmware Component Library"

config WISMOD_FW_COMPONENT_LIB
    bool "Enable WisMOD firmware component library"
    default n
    depends on FLASH_MAP
    select CRC
    help
      Enable storage and validation for a small replaceable firmware
      component payload stored outside the main MCUboot image slots.

config WISMOD_FW_COMPONENT_RAM_MAX
    int "Maximum runtime RAM declared by a firmware component"
    default 8192
    range 0 8192
    depends on WISMOD_FW_COMPONENT_LIB
    help
      Maximum private runtime RAM, in bytes, that a component image may
      declare in its header.

config WISMOD_FW_COMPONENT_STORE_DIRECT_FLASH
    bool "Store component DFU payload directly in component slot flash"
    default n
    depends on WISMOD_FW_COMPONENT_LIB
    help
      Write received component DFU payloads directly to component_slot_partition
      instead of staging them in shared_upgrade_ram first. Keep this disabled
      for boards that rely on RAM staging rollback behavior.

endmenu
```

## runtime/zephyr/modules/rtbus/Kconfig
```kconfig
menu "RTBus Library"
config RTBUS_LIB
    bool "Enable RTBus Library"
    default n

config RTBUS_ITERABLE_ENTRY
    bool "Register rtbus tasks through Zephyr iterable sections"
    depends on RTBUS_LIB
    default y
    help
      When enabled, rtbus tasks are registered with STRUCT_SECTION_ITERABLE.
      When disabled, rtbus_init() uses the explicit rtbus_entry_t table passed
      by the caller.

config RTBUS_DELAYED_EVENT_DEPTH
    int "Delayed event queue depth"
    depends on RTBUS_LIB
    default 8
    help
      Maximum number of delayed events owned by the rtbus facade.

config RTBUS_DELAYED_EVENT_PAYLOAD_MAX
    int "Delayed event payload size"
    depends on RTBUS_LIB
    default 32
    help
      Maximum payload bytes copied into one delayed event.

config RTBUS_NATIVE_SERVICE
    bool "Enable RTBus native service subsystem"
    depends on RTBUS_LIB
    depends on FLASH_MAP
    depends on MULTITHREADING
    depends on EVENTS
    depends on SERIAL
    depends on GPIO
    select CRC
    default n
    help
      Enable the RTBus native service. This subsystem loads the RTBus image,
      installs the existing runtime ABI table, and runs the native application
      thread.

config RTBUS_DIAGNOSTICS_SERVICE
    bool "Enable RTBus diagnostics service"
    depends on RTBUS_NATIVE_SERVICE
    default y
    help
      Enable the RTBus diagnostics task used by native applications and
      Arduino sketches to exercise the runtime post, result write-back, and
      completion wait path. Disable this for minimal production runtimes that
      do not need built-in diagnostics.

config RTBUS_RUNTIME_TIMEOUT_MAX_MS
    int "Maximum RTBus runtime wait timeout in milliseconds"
    default 100
    range 1 60000
    depends on RTBUS_NATIVE_SERVICE
    help
      Maximum timeout passed to the RTBus runtime event wait. This is also used
      when RTBus has no pending delayed event.

config RTBUS_RUNTIME_THREAD_STACK_SIZE
    int "RTBus runtime thread stack size"
    default 1024
    range 512 8192
    depends on RTBUS_NATIVE_SERVICE
    help
      Stack size for the Zephyr thread that initializes RTBus and runs the
      rtbus_process() loop. Increase this on profiles whose RTBus tasks call
      stack-heavy subsystems such as Bluetooth settings loading.

config RTBUS_RUNTIME_THREAD_PRIORITY
    int "RTBus runtime thread priority"
    default 9
    range 0 15
    depends on RTBUS_NATIVE_SERVICE
    help
      Preemptive Zephyr priority used by the RTBus runtime thread.

config RTBUS_IMAGE_RAM_MAX
    int "Maximum runtime RAM declared by an RTBus image"
    default 8192
    range 0 8192
    depends on RTBUS_NATIVE_SERVICE
    help
      Maximum private runtime RAM, in bytes, that an RTBus image may declare in
      its header.
endmenu
```

## runtime/zephyr/runtime/Kconfig
```kconfig
mainmenu "RTBus runtime configuration"

config NORDIC_HV_REGOUT0_3V3
	bool "Set Nordic HV REGOUT0 and SX1262 TCXO to 3.3 V"
	depends on SOC_NRF52840
	help
	  Program UICR REGOUT0 for a 3.3 V VDD and GPIO domain when the
	  nRF52840 is powered through VDDH, and configure the SX1262 DIO3
	  TCXO control voltage for 3.3 V. The device resets once after
	  changing UICR. Leave this disabled to preserve the existing
	  REGOUT0 setting and use the default TCXO voltage from the board runtime
	  overlay.

config RTBUS_NATIVE_API_TABLE_BASE
	hex "RTBus native application API table base address"
	default 0x2003FF00
	help
	  Fixed RAM address used by the runtime and native application payload to
	  exchange the RTBus native API table. Board profiles with smaller SRAM must
	  place this inside their reserved shared_ram devicetree node.

config RTBUS_OTA_SHARED_DATA_ADDR
	hex "RTBus OTA monitor shared data address"
	default 0x2003F400
	help
	  Fixed RAM address used by the runtime/FUOTA code and MCUboot to exchange
	  OTA monitor state. Board profiles with smaller SRAM must override this
	  together with the bootloader configuration.

config RUNTIME_POOL_SIZE
	int "Runtime schedule parameter pool size"
	default 4096
	range 256 65536
	help
	  Static byte pool passed to schedule_init() for runtime event parameter
	  allocation. Small RAM targets can override this in their board
	  runtime.conf.

rsource "../modules/rtbus/Kconfig"

source "Kconfig.zephyr"
```

## zephyr/modules/rtbus/Kconfig
```kconfig
menu "RTBus Library"
config RTBUS_LIB
    bool "Enable RTBus Library"
    default n

config RTBUS_ITERABLE_ENTRY
    bool "Register rtbus tasks through Zephyr iterable sections"
    depends on RTBUS_LIB
    default y
    help
      When enabled, rtbus tasks are registered with STRUCT_SECTION_ITERABLE.
      When disabled, rtbus_init() uses the explicit rtbus_entry_t table passed
      by the caller.

config RTBUS_DELAYED_EVENT_DEPTH
    int "Delayed event queue depth"
    depends on RTBUS_LIB
    default 8
    help
      Maximum number of delayed events owned by the rtbus facade.

config RTBUS_DELAYED_EVENT_PAYLOAD_MAX
    int "Delayed event payload size"
    depends on RTBUS_LIB
    default 32
    help
      Maximum payload bytes copied into one delayed event.

config RTBUS_NATIVE_SERVICE
    bool "Enable RTBus native service subsystem"
    depends on RTBUS_LIB
    depends on FLASH_MAP
    depends on MULTITHREADING
    depends on EVENTS
    depends on SERIAL
    depends on GPIO
    select CRC
    default n
    help
      Enable the RTBus native service. This subsystem loads the RTBus image,
      installs the existing runtime ABI table, and runs the native application
      thread.

config RTBUS_DIAGNOSTICS_SERVICE
    bool "Enable RTBus diagnostics service"
    depends on RTBUS_NATIVE_SERVICE
    default y
    help
      Enable the RTBus diagnostics task used by native applications and
      Arduino sketches to exercise the runtime post, result write-back, and
      completion wait path. Disable this for minimal production runtimes that
      do not need built-in diagnostics.

config RTBUS_RUNTIME_TIMEOUT_MAX_MS
    int "Maximum RTBus runtime wait timeout in milliseconds"
    default 100
    range 1 60000
    depends on RTBUS_NATIVE_SERVICE
    help
      Maximum timeout passed to the RTBus runtime event wait. This is also used
      when RTBus has no pending delayed event.

config RTBUS_RUNTIME_THREAD_STACK_SIZE
    int "RTBus runtime thread stack size"
    default 1024
    range 512 8192
    depends on RTBUS_NATIVE_SERVICE
    help
      Stack size for the Zephyr thread that initializes RTBus and runs the
      rtbus_process() loop. Increase this on profiles whose RTBus tasks call
      stack-heavy subsystems such as Bluetooth settings loading.

config RTBUS_RUNTIME_THREAD_PRIORITY
    int "RTBus runtime thread priority"
    default 9
    range 0 15
    depends on RTBUS_NATIVE_SERVICE
    help
      Preemptive Zephyr priority used by the RTBus runtime thread.

config RTBUS_RUNTIME_SERIAL_RX_BUFFER_SIZE
    int "Runtime serial RX buffer size"
    default 2048
    range 256 65536
    depends on RTBUS_NATIVE_SERVICE
    help
      Receive ring buffer size, in bytes, for each RTBus runtime serial port.
      Increase this on USB CDC profiles when testing sender implementations
      that stream YMODEM packets faster than the receiver can ACK them.

config RTBUS_IMAGE_RAM_MAX
    int "Maximum runtime RAM declared by an RTBus image"
    default 8192
    range 0 8192
    depends on RTBUS_NATIVE_SERVICE
    help
      Maximum private runtime RAM, in bytes, that an RTBus image may declare in
      its header.

config RTBUS_IMAGE_FLASH_PENDING_MAX
    int "RTBus image flash pending buffer size"
    default 256
    range 1 4096
    depends on RTBUS_NATIVE_SERVICE
    help
      Size, in bytes, of the RAM buffer used to coalesce RTBus image store
      writes before flushing them to flash. Increase this on profiles with more
      RAM to reduce flash write calls, or decrease it on constrained profiles.
      The value must be at least the flash write alignment and must be an exact
      multiple of that alignment.

config RTBUS_YMODEM_FLASH_STORE
    bool "Store YMODEM DFU payloads to flash"
    default y
    depends on RTBUS_NATIVE_SERVICE
    help
      When enabled, the YMODEM receiver writes received DFU payloads through
      the RTBus image store. Disable this to test the YMODEM protocol path
      without erase, write, verify, or commit flash operations.
endmenu
```

## zephyr/modules/rtbus/dts/bindings/rtbus,native-gpio.yaml
```yaml
description: RTBus native application GPIO export map

compatible: "rtbus,native-gpio"

child-binding:
  description: GPIO exported to native applications

  properties:
    rtbus,pin:
      type: int
      required: true
      description: Native application pin number.

    gpios:
      type: phandle-array
      required: true
      description: GPIO controlled by this native application pin.
```
